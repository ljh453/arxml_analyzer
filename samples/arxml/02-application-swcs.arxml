AUTOSAR XML (schema 4.0)
package /ApplicationSwcs
  application sw component type SensorFusionSwc
    provide port P_VehicleState: provided-interface=VehicleState_I
    require port R_ActuatorFeedback: required-interface=ActuatorFeedback_I
    behavior SensorFusionSwc_IB
      runnable ReadSensors
      runnable PublishVehicleState
  application sw component type VehicleControllerSwc
    require port R_VehicleState: required-interface=VehicleState_I
    require port R_PowerStageStatus: required-interface=PowerStageStatus_I
    require port R_DiagnosticEvent: required-interface=DiagnosticEvent_I
    provide port P_TorqueRequest: provided-interface=TorqueRequest_I
    behavior VehicleControllerSwc_IB
      runnable EvaluateVehicleState
      runnable ComputeTorqueRequest
  application sw component type ActuatorManagerSwc
    require port R_TorqueRequest: required-interface=TorqueRequest_I
    provide port P_ActuatorFeedback: provided-interface=ActuatorFeedback_I
    provide port P_IoHwCommand: provided-interface=IoHwCommand_I
    behavior ActuatorManagerSwc_IB
      runnable ApplyTorqueRequest
      runnable PublishActuatorFeedback
  service sw component type DiagnosticServiceSwc
    provide port P_DiagnosticEvent: provided-interface=DiagnosticEvent_I
    behavior DiagnosticServiceSwc_IB
      runnable HandleDiagnosticEvent
