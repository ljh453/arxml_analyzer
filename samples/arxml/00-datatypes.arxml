AUTOSAR XML (schema 4.0)
standard types defined: uint8, uint16
package /DataTypes/ImplementationTypes
  6 x impl type, all with category=VALUE:
    VehicleSpeed_T
    TorqueValue_T
    ActuatorPosition_T
    IoHwDuty_T
    DiagnosticCode_T
    Boolean_T
