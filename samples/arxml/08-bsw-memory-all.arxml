AUTOSAR XML (schema 4.0)
package /BswMemoryValues
  module config NvM_Config: definition=NvM
    NvMBlockDescriptor ()
  module config MemIf_Config: definition=MemIf
    MemIfConfigSet ()
  module config Fee_Config: definition=Fee
    FeeConfigSet ()
  module config Ea_Config: definition=Ea
    EaConfigSet ()
  module config Eep_Config: definition=Eep
    EepConfigSet ()
