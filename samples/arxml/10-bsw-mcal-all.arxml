AUTOSAR XML (schema 4.0)
package /BswMcalValues
  module config Adc_Config: definition=Adc
    AdcConfigSet ()
  module config Can_Config: definition=Can
    CanConfigSet ()
  module config Dio_Config: definition=Dio
    DioConfigSet ()
  module config Eth_Config: definition=Eth
    EthConfigSet ()
  module config Fls_Config: definition=Fls
    FlsConfigSet ()
  module config Gpt_Config: definition=Gpt
    GptConfigSet ()
  module config Icu_Config: definition=Icu
    IcuConfigSet ()
  module config Lin_Config: definition=Lin
    LinConfigSet ()
  module config Mcu_Config: definition=Mcu
    McuModuleConfiguration ()
  module config Port_Config: definition=Port
    PortConfigSet ()
  module config Pwm_Config: definition=Pwm
    PwmConfigSet ()
  module config Spi_Config: definition=Spi
    SpiConfigSet ()
  module config Wdg_Config: definition=Wdg
    WdgConfigSet ()
  module config Ocu_Config: definition=Ocu
    OcuConfigSet ()
