AUTOSAR XML (schema 4.0)
package /BswServicesValues
  module config BswM_Config: definition=BswM
    BswMConfigSet ()
  module config ComM_Config: definition=ComM
    ComMConfigSet ()
  module config Det_Config: definition=Det
    DetConfigSet ()
  module config Dem_Config: definition=Dem
    DemConfigSet ()
  module config Dcm_Config: definition=Dcm
    DcmDslProtocolRow ()
  module config E2E_Config: definition=E2E
    E2EConfigSet ()
  module config EcuM_Config: definition=EcuM
    EcuMConfigSet ()
  module config FiM_Config: definition=FiM
    FiMConfigSet ()
  module config StbM_Config: definition=StbM
    StbMConfigSet ()
  module config WdgM_Config: definition=WdgM
    WdgMConfigSet ()
  module config Crc_Config: definition=Crc
    CrcConfigSet ()
  module config Csm_Config: definition=Csm
    CsmConfigSet ()
  module config SecOC_Config: definition=SecOC
    SecOCConfigSet ()
  module config Xcp_Config: definition=Xcp
    XcpConfigSet ()
  module config Os_Config: definition=Os
    OsConfigSet ()
  module config SchM_Config: definition=SchM
    SchMConfigSet ()
