AUTOSAR XML (schema 4.0)
package /Interfaces
  5 x sender receiver interface:
    VehicleState_I
      data VehicleSpeed: type=VehicleSpeed_T
      data BrakeApplied: type=Boolean_T
    TorqueRequest_I
      data RequestedTorque: type=TorqueValue_T
    ActuatorFeedback_I
      data ActualPosition: type=ActuatorPosition_T
      data DriverReady: type=Boolean_T
    IoHwCommand_I
      data DutyPercent: type=IoHwDuty_T
      data EnableOutput: type=Boolean_T
    PowerStageStatus_I
      data CurrentFeedback: type=ActuatorPosition_T
      data FaultCode: type=DiagnosticCode_T
  client server interface DiagnosticEvent_I
    operation ReportEventStatus
