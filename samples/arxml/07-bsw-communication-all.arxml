AUTOSAR XML (schema 4.0)
package /BswCommunicationValues
  module config CanIf_Config: definition=CanIf
    CanIfInitCfg ()
  module config CanTp_Config: definition=CanTp
    CanTpConfigSet ()
  module config CanNm_Config: definition=CanNm
    CanNmConfigSet ()
  module config CanSM_Config: definition=CanSM
    CanSMConfigSet ()
  module config Com_Config: definition=Com
    ComConfig ()
  module config ComXf_Config: definition=ComXf
    ComXfConfigSet ()
  module config PduR_Config: definition=PduR
    PduRRoutingTables ()
  module config IpduM_Config: definition=IpduM
    IpduMConfigSet ()
  module config SoAd_Config: definition=SoAd
    SoAdConfigSet ()
  module config DoIP_Config: definition=DoIP
    DoIPConfigSet ()
  module config Sd_Config: definition=Sd
    SdConfigSet ()
  module config TcpIp_Config: definition=TcpIp
    TcpIpConfigSet ()
  module config UdpNm_Config: definition=UdpNm
    UdpNmConfigSet ()
  module config Nm_Config: definition=Nm
    NmConfigSet ()
  module config LinIf_Config: definition=LinIf
    LinIfConfigSet ()
  module config LinTp_Config: definition=LinTp
    LinTpConfigSet ()
  module config LinSM_Config: definition=LinSM
    LinSMConfigSet ()
  module config FrIf_Config: definition=FrIf
    FrIfConfigSet ()
  module config FrTp_Config: definition=FrTp
    FrTpConfigSet ()
  module config FrNm_Config: definition=FrNm
    FrNmConfigSet ()
  module config EthIf_Config: definition=EthIf
    EthIfConfigSet ()
  module config EthSM_Config: definition=EthSM
    EthSMConfigSet ()
  module config J1939Tp_Config: definition=J1939Tp
    J1939TpConfigSet ()
