AUTOSAR XML (schema 4.0)
package /BswEcuAbstractionValues
  module config IoHwAb_Config: definition=IoHwAb
    IoHwAbChannelGroup ()
  module config CanTrcv_Config: definition=CanTrcv
    CanTrcvConfigSet ()
  module config EthTrcv_Config: definition=EthTrcv
    EthTrcvConfigSet ()
  module config LinTrcv_Config: definition=LinTrcv
    LinTrcvConfigSet ()
  module config FrTrcv_Config: definition=FrTrcv
    FrTrcvConfigSet ()
  module config WdgIf_Config: definition=WdgIf
    WdgIfConfigSet ()
  module config MemAcc_Config: definition=MemAcc
    MemAccConfigSet ()
