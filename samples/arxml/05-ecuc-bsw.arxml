AUTOSAR XML (schema 4.0)
package /EcucValues
  module config IoHwAb_Config: definition=IoHwAb
    IoHwAbChannelGroup ()
  module config Dem_Config: definition=Dem
    DemConfigSet ()
  module config Dcm_Config: definition=Dcm
    DcmDslProtocolRow ()
  module config Com_Config: definition=Com
  module config PduR_Config: definition=PduR
  module config CanIf_Config: definition=CanIf
  module config NvM_Config: definition=NvM
  module config Mcu_Config: definition=Mcu
