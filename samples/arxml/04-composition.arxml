AUTOSAR XML (schema 4.0)
package /Compositions
  composition sw component type VehicleControlComposition
    5 x component:
      SensorFusion_Instance: type=SensorFusionSwc
      VehicleController_Instance: type=VehicleControllerSwc
      ActuatorManager_Instance: type=ActuatorManagerSwc
      PowerStageCdd_Instance: type=PowerStageCdd
      DiagnosticService_Instance: type=DiagnosticServiceSwc
    connect SensorFusion_Instance.P_VehicleState -> VehicleController_Instance.R_VehicleState
    connect VehicleController_Instance.P_TorqueRequest -> ActuatorManager_Instance.R_TorqueRequest
    connect ActuatorManager_Instance.P_ActuatorFeedback -> SensorFusion_Instance.R_ActuatorFeedback
    connect ActuatorManager_Instance.P_IoHwCommand -> PowerStageCdd_Instance.R_IoHwCommand
    connect PowerStageCdd_Instance.P_PowerStageStatus -> VehicleController_Instance.R_PowerStageStatus
    connect DiagnosticService_Instance.P_DiagnosticEvent -> VehicleController_Instance.R_DiagnosticEvent
